## boards/shields/vkey29/Kconfig.defconfig
```kconfig
if SHIELD_VKEY29_LEFT

config ZMK_SPLIT_ROLE_CENTRAL
    default y

endif

if SHIELD_VKEY29_LEFT || SHIELD_VKEY29_RIGHT

config ZMK_SPLIT
    default y

endif
```
